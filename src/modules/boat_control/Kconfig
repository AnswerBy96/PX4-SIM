## src/modules/boat_control/Kconfig
```kconfig
menuconfig MODULES_BOAT_CONTROL
	bool "boat_control"
	default n
	---help---
		Enable support for control of different-directional boats
```

## src/modules/chassis_data/Kconfig
```kconfig
menuconfig MODULES_CHASSIS_DATA
	bool "chassis_data"
	default n
	---help---
		Enable support for chassis_data
```

## src/modules/custom_commander/Kconfig
```kconfig
menuconfig MODULES_CUSTOM_COMMANDER
	bool "custom_commander"
	default n
	---help---
		Enable support for custom_commander
```

## src/modules/eboat_mavlink/Kconfig
```kconfig
menuconfig MODULES_EBOAT_MAVLINK
	bool "eboat_mavlink"
	default n
	---help---
		Enable support for eboat_mavlink
```

## src/modules/motor_driver/Kconfig
```kconfig
menuconfig MODULES_MOTOR_DRIVER
	bool "motor_driver"
	default n
	---help---
		Enable support for motor_driver
```

## src/modules/plc_connection_px4/Kconfig
```kconfig
menuconfig MODULES_PLC_CONNECTION_PX4
	bool "plc_connection_px4"
	default n
	---help---
		Enable support for plc_connection_px4
```

## src/modules/plc_data/Kconfig
```kconfig
menuconfig MODULES_PLC_DATA
	bool "plc_data"
	default n
	---help---
		Enable support for plc_data
```
